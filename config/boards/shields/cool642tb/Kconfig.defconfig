## config/boards/shields/cool642tb/Kconfig.defconfig
```kconfig
if SHIELD_COOL642TB_R

config ZMK_KEYBOARD_NAME
    default "cool642tb_R"

config ZMK_SPLIT
    default y

config ZMK_SPLIT_ROLE_CENTRAL
    default y

endif

if SHIELD_COOL642TB_L

config ZMK_KEYBOARD_NAME
    default "cool642tb_L"

config ZMK_SPLIT
    default y

endif
```

## config/west.yml
```yaml
manifest:
  remotes:
    - name: zmkfirmware
      url-base: https://github.com/zmkfirmware
    - name: telzo2000
      url-base: https://github.com/telzo2000
    - name: caksoylar
      url-base: https://github.com/caksoylar
  projects:
    - name: zmk
      remote: zmkfirmware
      revision: main
      import: app/west.yml
    - name: zmk-pmw3610-driver
      remote: telzo2000
      revision: main
    - name: zmk-rgbled-widget
      remote: caksoylar
      revision: main
  self:
    path: config
```

## dts/bindings/behaviors/behavior-smart-trans.yaml
```yaml
title: Smart Transparent Behavior
compatible: "zmk,behavior-smart-trans"
description: |
  Deactivate all non-0 layers then re-fire the Layer-0 binding at the same
  key position. Works with &mt / &mo, etc.
properties:
  "#binding-cells":
    const: 0
```
